## CMakeLists.txt
```
cmake_minimum_required(VERSION 3.20.0)

find_package(Zephyr REQUIRED HINTS $ENV{ZEPHYR_BASE})
project(kids_night_clock LANGUAGES C)

target_sources(app PRIVATE src/main.c src/graphics.c src/settings.c src/input.c)
```

## prj.conf
```kconfig
CONFIG_STDOUT_CONSOLE=y
CONFIG_PRINTK=y
CONFIG_MAIN_STACK_SIZE=16384
CONFIG_HEAP_MEM_POOL_SIZE=65536
CONFIG_GPIO=y
CONFIG_INPUT=y
CONFIG_DISPLAY=y
CONFIG_DISPLAY_LOG_LEVEL_ERR=y
CONFIG_LVGL=y
CONFIG_LV_Z_POINTER_INPUT=y
CONFIG_LV_Z_BUTTON_INPUT=y
CONFIG_LV_Z_ENCODER_INPUT=y
CONFIG_LV_Z_KEYPAD_INPUT=y
CONFIG_LV_Z_MEM_POOL_SIZE=32768
CONFIG_LV_USE_LOG=y
CONFIG_LV_USE_LABEL=y
CONFIG_LV_USE_ARC=y
CONFIG_LV_FONT_MONTSERRAT_14=y
CONFIG_LV_FONT_MONTSERRAT_28=y
CONFIG_LOG=y
CONFIG_LOG_DEFAULT_LEVEL=3
```

## src/main.c
```c
/*
 * SPDX-License-Identifier: Apache-2.0
 */

#include <zephyr/device.h>
#include <zephyr/devicetree.h>
#include <zephyr/drivers/display.h>
#include <zephyr/kernel.h>
#include <zephyr/logging/log.h>
#include <lvgl.h>
#include "graphics.h"
#include "settings.h"

LOG_MODULE_REGISTER(kids_alarm_clock);

int main(void)
{
    const struct device *display_dev = DEVICE_DT_GET(DT_CHOSEN(zephyr_display));
    int ret;

    if (!device_is_ready(display_dev)) {
        LOG_ERR("Display device is not ready");
        return -ENODEV;
    }

    lv_obj_t *screen = lv_scr_act();

    graphics_init(screen);
    settings_init(screen);

    lv_timer_create(graphics_tick, 1000, NULL);

    ret = display_blanking_off(display_dev);
    if (ret < 0 && ret != -ENOSYS) {
        LOG_ERR("Failed to turn display blanking off: %d", ret);
        return ret;
    }

    while (1) {
        lv_timer_handler();
        k_sleep(K_MSEC(20));
    }
}
```

## src/graphics.c
```c
#include "graphics.h"
#include <lvgl.h>
#include <zephyr/kernel.h>
#include <stdbool.h>
#include <stdint.h>
#include <math.h>

#ifndef M_PI
#define M_PI 3.14159265358979323846
#endif

#define INITIAL_HOUR 8
#define INITIAL_MINUTE 0
#define INITIAL_SECOND 0
#define HOUR_MARKER_LENGTH 14
#define HOUR_MARKER_WIDTH 6
#define HOUR_HAND_WIDTH 8
#define MINUTE_HAND_WIDTH 6
#define SECOND_HAND_WIDTH 3

static lv_obj_t *background_obj;
static lv_obj_t *dial_outline;
static lv_obj_t *hour_hand;
static lv_obj_t *minute_hand;
static lv_obj_t *second_hand;
static lv_obj_t *hour_markers[12];
static lv_obj_t *hour_numbers[12];

static lv_point_precise_t hour_hand_points[2];
static lv_point_precise_t minute_hand_points[2];
static lv_point_precise_t second_hand_points[2];
static lv_point_precise_t hour_marker_points[12][2];

static int current_hour = INITIAL_HOUR;
static int current_minute = INITIAL_MINUTE;
static int current_second = INITIAL_SECOND;
static int day_hour = 8;
static int day_minute = 0;
static int night_hour = 21;
static int night_minute = 0;

static inline int min_int(int a, int b)
{
    return a < b ? a : b;
}

static bool time_in_interval(int current, int start, int end)
{
    if (start <= end) {
        return current >= start && current <= end;
    }

    return current >= start || current <= end;
}

static lv_color_t get_background_color(int hour_value, int minute_value)
{
    int current_minutes = hour_value * 60 + minute_value;
    int day_transition = day_hour * 60 + day_minute;
    int night_transition = night_hour * 60 + night_minute;
    int day_end = (night_transition + 24 * 60 - 1) % (24 * 60);
    int night_end = (day_transition + 24 * 60 - 1) % (24 * 60);

    if (time_in_interval(current_minutes, day_transition, day_end)) {
        return lv_color_make(0xCC, 0xEE, 0xCC);
    }

    if (time_in_interval(current_minutes, night_transition, night_end)) {
        return lv_color_make(0xFF, 0xCC, 0xCC);
    }

    return lv_color_make(0xDD, 0xDD, 0xDD);
}

static void set_line_points(lv_obj_t *obj, lv_point_precise_t points[2], int x0, int y0, int x1, int y1)
{
    points[0].x = x0;
    points[0].y = y0;
    points[1].x = x1;
    points[1].y = y1;
    lv_line_set_points(obj, points, 2);
    lv_obj_align(obj, LV_ALIGN_CENTER, 0, 0);
}

static void update_hand(lv_obj_t *hand, lv_point_precise_t points[2], int32_t angle_deg, int length)
{
    const int center = lv_obj_get_width(hand) / 2;
    const double rad = (90 - angle_deg) * M_PI / 180.0;
    const int x_end = center + (int)(cos(rad) * length);
    const int y_end = center - (int)(sin(rad) * length);

    set_line_points(hand, points, center, center, x_end, y_end);
}

static void update_background_color(void)
{
    if (background_obj) {
        lv_obj_set_style_bg_color(background_obj, get_background_color(current_hour, current_minute), 0);
    }
}

static void update_clock_hands(void)
{
    const int diameter = min_int(LV_HOR_RES, LV_VER_RES) - 24;
    const int radius = diameter / 2;
    const int hour_angle = (current_hour % 12) * 30 + (current_minute * 30) / 60;
    const int minute_angle = current_minute * 6 + (current_second * 6) / 60;
    const int second_angle = current_second * 6;

    update_hand(hour_hand, hour_hand_points, hour_angle, radius * 50 / 100);
    update_hand(minute_hand, minute_hand_points, minute_angle, radius * 70 / 100);
    update_hand(second_hand, second_hand_points, second_angle, radius * 88 / 100);
}

void graphics_init(lv_obj_t *screen)
{
    const int diameter = min_int(LV_HOR_RES, LV_VER_RES) - 24;
    const int outer_radius = diameter / 2;

    background_obj = lv_obj_create(screen);
    lv_obj_set_size(background_obj, LV_HOR_RES, LV_VER_RES);
    lv_obj_set_style_bg_color(background_obj, get_background_color(current_hour, current_minute), 0);
    lv_obj_set_style_bg_opa(background_obj, LV_OPA_COVER, 0);
    lv_obj_clear_flag(background_obj, LV_OBJ_FLAG_SCROLLABLE);

    dial_outline = lv_obj_create(background_obj);
    lv_obj_set_size(dial_outline, diameter, diameter);
    lv_obj_align(dial_outline, LV_ALIGN_CENTER, 0, 0);
    lv_obj_set_style_bg_opa(dial_outline, LV_OPA_TRANSP, 0);
    lv_obj_set_style_border_color(dial_outline, lv_color_white(), 0);
    lv_obj_set_style_border_width(dial_outline, 5, 0);
    lv_obj_set_style_radius(dial_outline, LV_RADIUS_CIRCLE, 0);

    for (int i = 0; i < 12; i++) {
        lv_obj_t *marker = lv_line_create(background_obj);
        lv_obj_set_size(marker, diameter, diameter);
        lv_obj_set_style_line_width(marker, HOUR_MARKER_WIDTH, LV_PART_MAIN);
        lv_obj_set_style_line_color(marker, lv_color_white(), LV_PART_MAIN);
        lv_obj_set_style_line_rounded(marker, true, LV_PART_MAIN);

        const int angle = i * 30;
        const double rad = (90 - angle) * M_PI / 180.0;
        const int x_outer = diameter / 2 + (int)(cos(rad) * outer_radius);
        const int y_outer = diameter / 2 - (int)(sin(rad) * outer_radius);
        const int x_inner = diameter / 2 + (int)(cos(rad) * (outer_radius - HOUR_MARKER_LENGTH));
        const int y_inner = diameter / 2 - (int)(sin(rad) * (outer_radius - HOUR_MARKER_LENGTH));

        set_line_points(marker, hour_marker_points[i], x_inner, y_inner, x_outer, y_outer);
        hour_markers[i] = marker;

        lv_obj_t *number = lv_label_create(background_obj);
        lv_label_set_text_fmt(number, "%d", i == 0 ? 12 : i);
        lv_obj_set_style_text_color(number, lv_color_white(), 0);
        lv_obj_set_style_text_font(number, &lv_font_montserrat_14, 0);

        const int number_radius = outer_radius - 26;
        const int x_num = (int)(cos(rad) * number_radius);
        const int y_num = (int)(-sin(rad) * number_radius);
        lv_obj_align(number, LV_ALIGN_CENTER, x_num, y_num);
        hour_numbers[i] = number;
    }

    hour_hand = lv_line_create(background_obj);
    lv_obj_set_size(hour_hand, diameter, diameter);
    lv_obj_set_style_line_width(hour_hand, HOUR_HAND_WIDTH, LV_PART_MAIN);
    lv_obj_set_style_line_color(hour_hand, lv_color_black(), LV_PART_MAIN);
    lv_obj_set_style_line_rounded(hour_hand, true, LV_PART_MAIN);

    minute_hand = lv_line_create(background_obj);
    lv_obj_set_size(minute_hand, diameter, diameter);
    lv_obj_set_style_line_width(minute_hand, MINUTE_HAND_WIDTH, LV_PART_MAIN);
    lv_obj_set_style_line_color(minute_hand, lv_color_black(), LV_PART_MAIN);
    lv_obj_set_style_line_rounded(minute_hand, true, LV_PART_MAIN);

    second_hand = lv_line_create(background_obj);
    lv_obj_set_size(second_hand, diameter, diameter);
    lv_obj_set_style_line_width(second_hand, SECOND_HAND_WIDTH, LV_PART_MAIN);
    lv_obj_set_style_line_color(second_hand, lv_color_make(0xDD, 0x33, 0x33), LV_PART_MAIN);
    lv_obj_set_style_line_rounded(second_hand, true, LV_PART_MAIN);

    update_clock_hands();
}

void graphics_set_time(int hour_value, int minute_value, int second_value)
{
    current_hour = hour_value;
    current_minute = minute_value;
    current_second = second_value;
    update_background_color();
    update_clock_hands();
}

void graphics_set_transition_times(int day_hour_value, int day_minute_value, int night_hour_value, int night_minute_value)
{
    day_hour = day_hour_value;
    day_minute = day_minute_value;
    night_hour = night_hour_value;
    night_minute = night_minute_value;
    update_background_color();
}

void graphics_get_time(int *hour_value, int *minute_value, int *second_value)
{
    if (hour_value) {
        *hour_value = current_hour;
    }
    if (minute_value) {
        *minute_value = current_minute;
    }
    if (second_value) {
        *second_value = current_second;
    }
}

void graphics_get_transition_times(int *day_hour_value, int *day_minute_value, int *night_hour_value, int *night_minute_value)
{
    if (day_hour_value) {
        *day_hour_value = day_hour;
    }
    if (day_minute_value) {
        *day_minute_value = day_minute;
    }
    if (night_hour_value) {
        *night_hour_value = night_hour;
    }
    if (night_minute_value) {
        *night_minute_value = night_minute;
    }
}

void graphics_tick(lv_timer_t *timer)
{
    ARG_UNUSED(timer);

    current_second++;
    if (current_second >= 60) {
        current_second = 0;
        current_minute++;
        if (current_minute >= 60) {
            current_minute = 0;
            current_hour = (current_hour + 1) % 24;
        }
        update_background_color();
    }
    update_clock_hands();
}
```

## src/graphics.h
```c
#ifndef GRAPHICS_H
#define GRAPHICS_H

#include <lvgl.h>

void graphics_init(lv_obj_t *screen);
void graphics_tick(lv_timer_t *timer);
void graphics_set_time(int hour, int minute, int second);
void graphics_set_transition_times(int day_hour, int day_minute, int night_hour, int night_minute);
void graphics_get_time(int *hour, int *minute, int *second);
void graphics_get_transition_times(int *day_hour, int *day_minute, int *night_hour, int *night_minute);

#endif /* GRAPHICS_H */
```

## src/input.c
```c
#include "input.h"
#include <lvgl.h>

lv_obj_t *input_create_button(lv_obj_t *parent, int width, int height, const char *label_text, lv_event_cb_t event_cb)
{
    lv_obj_t *btn = lv_btn_create(parent);
    lv_obj_set_size(btn, width, height);
    input_style_button(btn, lv_color_black(), LV_OPA_30);
    lv_obj_set_style_border_color(btn, lv_color_white(), LV_PART_MAIN);
    if (event_cb) {
        lv_obj_add_event_cb(btn, event_cb, LV_EVENT_CLICKED, NULL);
    }

    lv_obj_t *label = lv_label_create(btn);
    lv_label_set_text(label, label_text);
    lv_obj_center(label);

    return btn;
}

void input_style_button(lv_obj_t *btn, lv_color_t bg_color, lv_opa_t opa)
{
    lv_obj_set_style_bg_color(btn, bg_color, LV_PART_MAIN);
    lv_obj_set_style_bg_opa(btn, opa, LV_PART_MAIN);
    lv_obj_set_style_border_color(btn, lv_color_white(), LV_PART_MAIN);
}
```

## src/input.h
```c
#ifndef INPUT_H
#define INPUT_H

#include <lvgl.h>

lv_obj_t *input_create_button(lv_obj_t *parent, int width, int height, const char *label_text, lv_event_cb_t event_cb);
void input_style_button(lv_obj_t *btn, lv_color_t bg_color, lv_opa_t opa);

#endif /* INPUT_H */
```

## src/settings.c
```c
#include "settings.h"
#include "graphics.h"
#include "input.h"
#include <lvgl.h>

static lv_obj_t *settings_screen;
static lv_obj_t *settings_tab_btns[2];
static lv_obj_t *settings_page_containers[2];
static lv_obj_t *settings_time_field_btns[3];
static lv_obj_t *settings_time_value_labels[3];
static lv_obj_t *settings_transition_field_btns[4];
static lv_obj_t *settings_transition_value_labels[4];
static lv_obj_t *settings_inc_btn;
static lv_obj_t *settings_dec_btn;
static lv_obj_t *settings_prev_btn;
static lv_obj_t *settings_next_btn;
static lv_obj_t *settings_save_btn;
static lv_obj_t *settings_cancel_btn;

static int settings_hour;
static int settings_minute;
static int settings_second;
static int settings_day_hour = 8;
static int settings_day_minute = 0;
static int settings_night_hour = 21;
static int settings_night_minute = 0;
static int selected_tab;
static int selected_field;

static void update_settings_time_labels(void)
{
    lv_label_set_text_fmt(settings_time_value_labels[0], "%02d", settings_hour);
    lv_label_set_text_fmt(settings_time_value_labels[1], "%02d", settings_minute);
    lv_label_set_text_fmt(settings_time_value_labels[2], "%02d", settings_second);
}

static void update_settings_transition_labels(void)
{
    lv_label_set_text_fmt(settings_transition_value_labels[0], "%02d", settings_day_hour);
    lv_label_set_text_fmt(settings_transition_value_labels[1], "%02d", settings_day_minute);
    lv_label_set_text_fmt(settings_transition_value_labels[2], "%02d", settings_night_hour);
    lv_label_set_text_fmt(settings_transition_value_labels[3], "%02d", settings_night_minute);
}

static void update_settings_field_styles(void)
{
    for (int i = 0; i < 3; i++) {
        if (selected_tab == 0 && i == selected_field) {
            lv_obj_set_style_border_width(settings_time_field_btns[i], 3, LV_PART_MAIN);
            lv_obj_set_style_border_color(settings_time_field_btns[i], lv_color_make(0x33, 0x99, 0xFF), LV_PART_MAIN);
        } else {
            lv_obj_set_style_border_width(settings_time_field_btns[i], 1, LV_PART_MAIN);
            lv_obj_set_style_border_color(settings_time_field_btns[i], lv_color_white(), LV_PART_MAIN);
        }
    }

    for (int i = 0; i < 4; i++) {
        if (selected_tab == 1 && i == selected_field) {
            lv_obj_set_style_border_width(settings_transition_field_btns[i], 3, LV_PART_MAIN);
            lv_obj_set_style_border_color(settings_transition_field_btns[i], lv_color_make(0x33, 0x99, 0xFF), LV_PART_MAIN);
        } else {
            lv_obj_set_style_border_width(settings_transition_field_btns[i], 1, LV_PART_MAIN);
            lv_obj_set_style_border_color(settings_transition_field_btns[i], lv_color_white(), LV_PART_MAIN);
        }
    }

    for (int i = 0; i < 2; i++) {
        if (i == selected_tab) {
            lv_obj_set_style_bg_color(settings_tab_btns[i], lv_color_make(0x33, 0x99, 0xFF), LV_PART_MAIN);
            lv_obj_set_style_text_color(settings_tab_btns[i], lv_color_white(), 0);
        } else {
            lv_obj_set_style_bg_color(settings_tab_btns[i], lv_color_black(), LV_PART_MAIN);
            lv_obj_set_style_text_color(settings_tab_btns[i], lv_color_white(), 0);
        }
    }
}

static void hide_settings(void)
{
    lv_obj_add_flag(settings_screen, LV_OBJ_FLAG_HIDDEN);
}

static void set_active_settings_tab(int tab)
{
    selected_tab = tab;
    lv_obj_add_flag(settings_page_containers[0], LV_OBJ_FLAG_HIDDEN);
    lv_obj_add_flag(settings_page_containers[1], LV_OBJ_FLAG_HIDDEN);
    lv_obj_clear_flag(settings_page_containers[tab], LV_OBJ_FLAG_HIDDEN);
    selected_field = 0;
    update_settings_field_styles();
}

static void adjust_settings_field(int delta)
{
    if (selected_tab == 0) {
        if (selected_field == 0) {
            settings_hour = (settings_hour + delta + 24) % 24;
        } else if (selected_field == 1) {
            settings_minute = (settings_minute + delta + 60) % 60;
        } else {
            settings_second = (settings_second + delta + 60) % 60;
        }
        update_settings_time_labels();
    } else {
        if (selected_field == 0) {
            settings_day_hour = (settings_day_hour + delta + 24) % 24;
        } else if (selected_field == 1) {
            settings_day_minute = (settings_day_minute + delta + 60) % 60;
        } else if (selected_field == 2) {
            settings_night_hour = (settings_night_hour + delta + 24) % 24;
        } else {
            settings_night_minute = (settings_night_minute + delta + 60) % 60;
        }
        update_settings_transition_labels();
    }
}

static void select_next_field(void)
{
    int max_field = (selected_tab == 0) ? 3 : 4;
    selected_field = (selected_field + 1) % max_field;
    update_settings_field_styles();
}

static void select_previous_field(void)
{
    int max_field = (selected_tab == 0) ? 3 : 4;
    selected_field = (selected_field + max_field - 1) % max_field;
    update_settings_field_styles();
}

static void settings_event_cb(lv_event_t *e)
{
    lv_obj_t *target = lv_event_get_target(e);

    if (target == settings_tab_btns[0]) {
        set_active_settings_tab(0);
        return;
    }
    if (target == settings_tab_btns[1]) {
        set_active_settings_tab(1);
        return;
    }
    if (target == settings_prev_btn) {
        select_previous_field();
        return;
    }
    if (target == settings_next_btn) {
        select_next_field();
        return;
    }
    if (target == settings_inc_btn) {
        adjust_settings_field(1);
        return;
    }
    if (target == settings_dec_btn) {
        adjust_settings_field(-1);
        return;
    }
    if (target == settings_save_btn) {
        graphics_set_time(settings_hour, settings_minute, settings_second);
        graphics_set_transition_times(settings_day_hour, settings_day_minute, settings_night_hour, settings_night_minute);
        hide_settings();
        return;
    }
    if (target == settings_cancel_btn) {
        hide_settings();
        return;
    }

    if (selected_tab == 0) {
        for (int i = 0; i < 3; i++) {
            if (target == settings_time_field_btns[i]) {
                selected_field = i;
                update_settings_field_styles();
                return;
            }
        }
    } else {
        for (int i = 0; i < 4; i++) {
            if (target == settings_transition_field_btns[i]) {
                selected_field = i;
                update_settings_field_styles();
                return;
            }
        }
    }
}

static void gear_button_event_cb(lv_event_t *e)
{
    if (lv_event_get_code(e) == LV_EVENT_CLICKED) {
        lv_obj_clear_flag(settings_screen, LV_OBJ_FLAG_HIDDEN);
        lv_obj_move_foreground(settings_screen);
        settings_show();
    }
}

static lv_obj_t *create_setting_box(lv_obj_t *parent, const char *text, int x, int y)
{
    lv_obj_t *label = lv_label_create(parent);
    lv_label_set_text(label, text);
    lv_obj_set_style_text_color(label, lv_color_white(), 0);
    lv_obj_set_style_text_font(label, &lv_font_montserrat_14, 0);
    lv_obj_align(label, LV_ALIGN_TOP_LEFT, x, y);
    return label;
}

static lv_obj_t *create_time_field(lv_obj_t *parent, lv_obj_t **label)
{
    lv_obj_t *btn = lv_btn_create(parent);
    lv_obj_set_size(btn, 80, 60);
    lv_obj_set_style_border_width(btn, 1, LV_PART_MAIN);
    lv_obj_set_style_border_color(btn, lv_color_white(), LV_PART_MAIN);
    lv_obj_set_style_bg_color(btn, lv_color_black(), LV_PART_MAIN);
    lv_obj_set_style_bg_opa(btn, LV_OPA_20, LV_PART_MAIN);
    lv_obj_set_style_text_color(btn, lv_color_white(), 0);
    lv_obj_add_event_cb(btn, settings_event_cb, LV_EVENT_CLICKED, NULL);

    *label = lv_label_create(btn);
    lv_label_set_text(*label, "00");
    lv_obj_set_style_text_font(*label, &lv_font_montserrat_28, 0);
    lv_obj_center(*label);
    return btn;
}

static lv_obj_t *create_transition_field(lv_obj_t *parent, lv_obj_t **label)
{
    return create_time_field(parent, label);
}

static void create_gear_button(lv_obj_t *screen);

void settings_show(void);

static void create_gear_button(lv_obj_t *screen)
{
    lv_obj_t *gear_btn = lv_btn_create(screen);
    lv_obj_set_size(gear_btn, 40, 40);
    lv_obj_set_style_radius(gear_btn, 12, LV_PART_MAIN);
    lv_obj_set_style_bg_color(gear_btn, lv_color_make(0x22, 0x22, 0x22), LV_PART_MAIN);
    lv_obj_set_style_bg_opa(gear_btn, LV_OPA_70, LV_PART_MAIN);
    lv_obj_set_style_border_width(gear_btn, 1, LV_PART_MAIN);
    lv_obj_set_style_border_color(gear_btn, lv_color_white(), LV_PART_MAIN);
    lv_obj_align(gear_btn, LV_ALIGN_TOP_RIGHT, -10, 10);
    lv_obj_add_event_cb(gear_btn, gear_button_event_cb, LV_EVENT_CLICKED, NULL);

    lv_obj_t *label = lv_label_create(gear_btn);
#ifndef LV_SYMBOL_SETTINGS
#define LV_SYMBOL_SETTINGS "⚙"
#endif
    lv_label_set_text(label, LV_SYMBOL_SETTINGS);
    lv_obj_set_style_text_color(label, lv_color_white(), 0);
    lv_obj_center(label);
}

static void create_settings_content(void)
{
    const int field_width = 80;
    const int field_spacing = 12;
    const int base_x = -field_width - field_spacing;

    lv_obj_t *time_row = lv_obj_create(settings_page_containers[0]);
    lv_obj_set_size(time_row, LV_HOR_RES, 80);
    lv_obj_set_style_bg_opa(time_row, LV_OPA_TRANSP, 0);
    lv_obj_clear_flag(time_row, LV_OBJ_FLAG_SCROLLABLE);
    lv_obj_align(time_row, LV_ALIGN_TOP_MID, 0, 10);

    for (int i = 0; i < 3; i++) {
        settings_time_field_btns[i] = create_time_field(time_row, &settings_time_value_labels[i]);
        lv_obj_align(settings_time_field_btns[i], LV_ALIGN_CENTER, base_x + i * (field_width + field_spacing), 0);

        if (i < 2) {
            lv_obj_t *colon = lv_label_create(time_row);
            lv_label_set_text(colon, ":");
            lv_obj_set_style_text_font(colon, &lv_font_montserrat_28, 0);
            lv_obj_set_style_text_color(colon, lv_color_white(), 0);
            lv_obj_align(colon, LV_ALIGN_CENTER, base_x + i * (field_width + field_spacing) + field_width / 2 + field_spacing / 2, 0);
        }
    }

    create_setting_box(settings_page_containers[1], "Day", 20, 20);
    for (int i = 0; i < 2; i++) {
        settings_transition_field_btns[i] = create_transition_field(settings_page_containers[1], &settings_transition_value_labels[i]);
        lv_obj_align(settings_transition_field_btns[i], LV_ALIGN_TOP_MID, base_x + i * (field_width + field_spacing), 20);

        if (i == 0) {
            lv_obj_t *colon = lv_label_create(settings_page_containers[1]);
            lv_label_set_text(colon, ":");
            lv_obj_set_style_text_font(colon, &lv_font_montserrat_28, 0);
            lv_obj_set_style_text_color(colon, lv_color_white(), 0);
            lv_obj_align(colon, LV_ALIGN_TOP_MID, base_x + field_width + field_spacing / 2, 20);
        }
    }

    create_setting_box(settings_page_containers[1], "Night", 20, 110);
    for (int i = 0; i < 2; i++) {
        settings_transition_field_btns[2 + i] = create_transition_field(settings_page_containers[1], &settings_transition_value_labels[2 + i]);
        lv_obj_align(settings_transition_field_btns[2 + i], LV_ALIGN_TOP_MID, base_x + i * (field_width + field_spacing), 110);

        if (i == 0) {
            lv_obj_t *colon = lv_label_create(settings_page_containers[1]);
            lv_label_set_text(colon, ":");
            lv_obj_set_style_text_font(colon, &lv_font_montserrat_28, 0);
            lv_obj_set_style_text_color(colon, lv_color_white(), 0);
            lv_obj_align(colon, LV_ALIGN_TOP_MID, base_x + field_width + field_spacing / 2, 110);
        }
    }
}

static void create_navigation_buttons(void)
{
    settings_prev_btn = input_create_button(settings_screen, 56, 40, "<", settings_event_cb);
    lv_obj_align(settings_prev_btn, LV_ALIGN_BOTTOM_MID, -90, -140);

    settings_next_btn = input_create_button(settings_screen, 56, 40, ">", settings_event_cb);
    lv_obj_align(settings_next_btn, LV_ALIGN_BOTTOM_MID, 90, -140);

    settings_dec_btn = input_create_button(settings_screen, 80, 40, "-", settings_event_cb);
    lv_obj_align(settings_dec_btn, LV_ALIGN_BOTTOM_MID, -90, -90);

    settings_inc_btn = input_create_button(settings_screen, 80, 40, "+", settings_event_cb);
    lv_obj_align(settings_inc_btn, LV_ALIGN_BOTTOM_MID, 90, -90);
}

static void create_save_cancel_buttons(void)
{
    settings_save_btn = input_create_button(settings_screen, 100, 40, "Save", settings_event_cb);
    input_style_button(settings_save_btn, lv_color_make(0x33, 0x99, 0x33), LV_OPA_COVER);
    lv_obj_align(settings_save_btn, LV_ALIGN_BOTTOM_LEFT, 40, -20);

    settings_cancel_btn = input_create_button(settings_screen, 100, 40, "Cancel", settings_event_cb);
    input_style_button(settings_cancel_btn, lv_color_make(0x99, 0x33, 0x33), LV_OPA_COVER);
    lv_obj_align(settings_cancel_btn, LV_ALIGN_BOTTOM_RIGHT, -40, -20);
}

void settings_init(lv_obj_t *screen)
{
    settings_screen = lv_obj_create(screen);
    lv_obj_set_size(settings_screen, LV_HOR_RES, LV_VER_RES);
    lv_obj_set_style_bg_color(settings_screen, lv_color_make(0x11, 0x11, 0x11), 0);
    lv_obj_set_style_bg_opa(settings_screen, LV_OPA_COVER, 0);
    lv_obj_add_flag(settings_screen, LV_OBJ_FLAG_HIDDEN);
    lv_obj_clear_flag(settings_screen, LV_OBJ_FLAG_SCROLLABLE);

    lv_obj_t *title = lv_label_create(settings_screen);
    lv_label_set_text(title, "Settings");
    lv_obj_set_style_text_font(title, &lv_font_montserrat_14, 0);
    lv_obj_set_style_text_color(title, lv_color_white(), 0);
    lv_obj_align(title, LV_ALIGN_TOP_MID, 0, 8);

    const int tab_width = 100;

    settings_tab_btns[0] = input_create_button(settings_screen, tab_width, 32, "Time", settings_event_cb);
    lv_obj_align(settings_tab_btns[0], LV_ALIGN_TOP_LEFT, 20, 36);

    settings_tab_btns[1] = input_create_button(settings_screen, tab_width, 32, "Transition", settings_event_cb);
    lv_obj_align(settings_tab_btns[1], LV_ALIGN_TOP_LEFT, 140, 36);

    settings_page_containers[0] = lv_obj_create(settings_screen);
    lv_obj_set_size(settings_page_containers[0], LV_HOR_RES, LV_VER_RES - 100);
    lv_obj_set_style_bg_opa(settings_page_containers[0], LV_OPA_TRANSP, 0);
    lv_obj_clear_flag(settings_page_containers[0], LV_OBJ_FLAG_SCROLLABLE);
    lv_obj_align(settings_page_containers[0], LV_ALIGN_TOP_MID, 0, 70);

    settings_page_containers[1] = lv_obj_create(settings_screen);
    lv_obj_set_size(settings_page_containers[1], LV_HOR_RES, LV_VER_RES - 100);
    lv_obj_set_style_bg_opa(settings_page_containers[1], LV_OPA_TRANSP, 0);
    lv_obj_clear_flag(settings_page_containers[1], LV_OBJ_FLAG_SCROLLABLE);
    lv_obj_align(settings_page_containers[1], LV_ALIGN_TOP_MID, 0, 70);

    create_settings_content();
    create_navigation_buttons();
    create_save_cancel_buttons();
    create_gear_button(screen);

    set_active_settings_tab(0);
}

void settings_show(void)
{
    graphics_get_time(&settings_hour, &settings_minute, &settings_second);
    graphics_get_transition_times(&settings_day_hour, &settings_day_minute, &settings_night_hour, &settings_night_minute);
    update_settings_time_labels();
    update_settings_transition_labels();
    set_active_settings_tab(0);
    lv_obj_clear_flag(settings_screen, LV_OBJ_FLAG_HIDDEN);
    lv_obj_move_foreground(settings_screen);
}
```

## src/settings.h
```c
#ifndef SETTINGS_H
#define SETTINGS_H

#include <lvgl.h>

void settings_init(lv_obj_t *screen);
void settings_show(void);

#endif /* SETTINGS_H */
```
